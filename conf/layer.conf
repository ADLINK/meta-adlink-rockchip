## conf/layer.conf
```bitbake
#we have a conf and classes directory, add to BBPATH
BBPATH .= ":${LAYERDIR}"

# We have a packages directory, add to BBFILES
BBFILES += "${LAYERDIR}/recipes-*/*/*.bb \
            ${LAYERDIR}/recipes-*/*/*.bbappend"

BBFILE_PRIORITY_adlink-rockchip = "10"

BBFILE_COLLECTIONS += "adlink-rockchip"
BBFILE_PATTERN_adlink-rockchip := "^${LAYERDIR}"
LAYERSERIES_COMPAT_adlink-rockchip = "rocko thud zeus dunfell"
```
